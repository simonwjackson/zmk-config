## config/west.yml
```yaml
manifest:
  remotes:
    - name: zmkfirmware
      # Mouse-keys fork (beta)
      url-base: https://github.com/ftc/zmk
      # url-base: https://github.com/zmkfirmware
  projects:
    - name: zmk
      remote: zmkfirmware
      revision: main
      import: app/west.yml
  self:
    path: config
```
